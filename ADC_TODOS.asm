			PROCESSOR 16F887
			INCLUDE P16F887.INC
			__CONFIG _CONFIG1, _LVP_OFF & _FCMEN_ON & _IESO_OFF & _BOR_OFF & _CPD_OFF & _CP_OFF & _MCLRE_OFF & _PWRTE_ON & _WDT_OFF & _INTRC_OSC_NOCLKOUT
	   		__CONFIG _CONFIG2, _WRT_OFF & _BOR21V

RES_S 	EQU 7E
RES_W 	EQU 7D
DATO 	EQU	0x70
			ORG 0
			GOTO INICIO
			ORG 4
			GOTO INTERRUP

INICIO; INICIALIZA TODO
		BSF STATUS,RP0; ME CAMBIO AL BANCO 1
		CLRF TRISD ; PUERTO D PARA SALIDA
		BCF STATUS, RP0;
		CLRF PORTD; LIMPIANDO D
		 BANKSEL OPTION_REG
		MOVLW B'11010000'; CONF PARA EL TIMER; PRESCALADOR
		MOVWF OPTION_REG
		BANKSEL ADCON1
		MOVLW 0E
		MOVWF ADCON1; CONFIGURA EL ANALOGICO DIGITAL
		BCF STATUS, RP0; CAMBIO DE BANCO
		MOVLW		D'250'
		MOVWF		TMR0
		BSF INTCON, TMR0IE; HABILITANDO EL TIMER

		 BANKSEL ADCON1 ;
            	MOVLW B'10000000' ;JUSTIFICACIсN A LA IZQUIERDA
            	MOVWF ADCON1 ;Vdd Y Vss COMO Vref
            	BANKSEL TRISA ;
            	BSF TRISA,0 ;PONEMOS A RA0 COMO ENTRADA
            	BANKSEL ANSEL ;
           	 BSF ANSEL,0 ;PONEMOS A RA0 COMO ANALOGICO
           	 BANKSEL ADCON0 ;
            	;MOVLW B'11000001' ;ELEGIMOS EL RELOJ Frc DEL ADC
            	MOVWF ADCON0 ;Y ENCENDEMOS EL CONVERTIDOR
CICLO
		NOP
		GOTO CICLO

INTERRUP;TODO DE LAS INTERRUPCIONES
		
		CALL RESPALDO
		BTFSC INTCON, TMR0IF	;pregunta si se trata de la interrupcion TMR0
		CALL INTTIMER
		
		BTFSC PIR1, ADIF		;pregunta si se trata de  la interrupcion ADIF
		CALL INTANALOG

		CALL RECUPERANDO
		RETFIE

INTTIMER
		MOVLW D'250'			;inicializacion del timer para que no afecte el codigo
		MOVWF TMR0
		BCF PIR1,ADIF		;limpiando bandera de interrupcion
		BSF INTCON, PEIE	;habilitando interrupciones de perifericos 
		BSF ADCON0,2		;Iniciando conversion
		CALL INTANALOG
		BCF INTCON, TMR0IF  ;limpia la interrupcion de TMR0

		RETURN
INTANALOG
		BSF ADCON0,GO ;INICIA LA CONVERSION
            	BTFSC ADCON0,GO 
		BANKSEL ADRESL ;CAMBIO A BANCO1
           	 MOVF ADRESL,W ;LEE LA PARTE MENOS SIGNIFICATIVA
		MOVWF DATO ;GUARDALO EN DATO
                 BANKSEL PORTD ;CAMBIO A BANCO 0
	         MOVF DATO,W
		MOVWF PORTD
		RETURN



RESPALDO
		 MOVWF	RES_W
		 SWAPF STATUS, W
		 MOVWF RES_S
		 RETURN
RECUPERANDO
		SWAPF RES_S,W ;Swap STATUS_TEMP register into W
		MOVWF STATUS ;Move W into STATUS register
		SWAPF RES_W,F ;Swap W_TEMP
		SWAPF RES_W,W ;Swap W_TEMP into W
		RETURN

			END