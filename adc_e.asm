		PROCESSOR			16F887
		INCLUDE			P16F887.INC
		__CONFIG _CONFIG1, _LVP_OFF & _FCMEN_ON & _IESO_OFF & _BOR_OFF & _CPD_OFF & _CP_OFF & _MCLRE_OFF & _PWRTE_ON & _WDT_OFF & _INTRC_OSC_NOCLKOUT
	   	__CONFIG _CONFIG2, _WRT_OFF & _BOR21V

ESTADO			EQU		7D
STATUS_TEMP	EQU		7E
W_TEMP		EQU		7F

		ORG		0
		GOTO	INICIO
		ORG		04
		GOTO	INTER

INICIO	
;-------PUERTO------------
		BANKSEL TRISD
		CLRF	TRISD
		;BSF		STATUS,RP0
		BANKSEL PORTD
		CLRF	PORTD
;-------timer0--------------
		MOVLW	0D0				;TIMER0
		BANKSEL OPTION_REG
		MOVWF	OPTION_REG		;TIMER0
		;BCF		STATUS,RP0
;-------ADC---------------
		BANKSEL ADCON1 ;
		MOVLW	B'10000000'
		MOVWF	ADCON1
		BANKSEL TRISA
		BSF		TRISA,0
		BANKSEL ANSEL
		BSF		ANSEL,0
		MOVLW B'11000001'
		BANKSEL ADCON0 ;
		MOVWF ADCON0
		;BCF		STATUS,RP1
		;BCF		STATUS,RP0
		BSF		INTCON,TMR0IE
		BSF		INTCON,GIE
;--------------------------
CICLO
		NOP
		NOP
		NOP
		NOP
		GOTO	CICLO

INTER	MOVWF		W_TEMP
		SWAPF		STATUS,W
		MOVWF		STATUS_TEMP
		BTFSC	INTCON,TMR0IF
		GOTO	INTTMR0
		BTFSC	PIR1,ADIF
		GOTO	INTAD
		GOTO	FININT
INTTMR0
		NOP
		MOVLW	0C9
		BANKSEL TMR0
		MOVWF	TMR0
		MOVLW	B'11000001'
		BANKSEL ADCON0
		MOVWF	ADCON0
		BCF		PIR1,ADIF
		;BSF		STATUS,RP0
		BANKSEL PIE1
		BSF		PIE1,ADIE
		BCF		STATUS,RP0
		BSF		INTCON,PEIE
		BSF		ADCON0,2
		BCF		INTCON,TMR0IF
		GOTO	FININT

INTAD	
		BSF ADCON0,GO ;INICIA LA CONVERSION
      		BTFSC ADCON0,GO ;YA SE TERMINO LA CONVERSION?
        	GOTO $-1 ;NO? PREGUNTA DE NUEVOMOVF		ADRESH,W
		BANKSEL ADRESL
		MOVF ADRESL,W
		MOVWF	ESTADO
		BANKSEL PORTD
		MOVWF	PORTD
		;BSF		STATUS,RP0
		BANKSEL PIE1
		BCF		PIE1,ADIE
		;BCF		STATUS,RP0
		
		

FININT	SWAPF		STATUS_TEMP,W
		MOVWF	STATUS
		SWAPF		W_TEMP,F
		SWAPF		W_TEMP,W	
		RETFIE
	
		END