			PROCESSOR	16F887
			INCLUDE		P16F887.INC

			__CONFIG _CONFIG1, _LVP_OFF & _FCMEN_ON & _IESO_OFF & _BOR_OFF & _CPD_OFF & _CP_OFF & _MCLRE_OFF & _PWRTE_ON & _WDT_OFF & _INTRC_OSC_NOCLKOUT
	   		__CONFIG _CONFIG2, _WRT_OFF & _BOR21V

RES_W		EQU 			07E
RES_S		EQU			07F
DATO 		EQU			070
SAMPLE		EQU 			021

			ORG			0
			GOTO		INICIO
			ORG			4
			GOTO		INTERRUPTION_TMR
;---------------------------------------
INICIO
;-----------PORTB CONFIGURACION----------------------
			BSF 		STATUS,RP0 ;CAMBIO A BANCO 1
	       		CLRF 		TRISD ;CONFIGURO TODO PORTD COMO SALIDA
	        	BCF 		STATUS,RP0 ;CAMBIO A BANCO 0
	        	CLRF		 PORTD ;APAGO POSIBLES LATCHS EN PORTD
;-----------TMR0--------------------
			BSF                STATUS ,RP0
			MOVLW	0D2
			MOVWF	OPTION_REG
			BCF		STATUS,RP0
			MOVLW 	0E				;CONFIGURACION 1 DE CONVERTIDOR A/D
			MOVWF 	ADCON1
			BSF			INTCON,T0IE
			BSF			INTCON,TMR0IE
			BSF			INTCON,GIE
			MOVLW	0FA
			MOVWF	TMR0
			CALL INIT_ADQUI

CICLO
			NOP
			NOP
			NOP
			NOP	
			GOTO			CICLO
;--------------------------------

RESPALDO_1
		 MOVWF		RES_W
		 SWAPF 		STATUS, W
		 MOVWF 		RES_S
		 RETURN
RESPALDO_2
		SWAPF 			RES_S,W ;Swap STATUS_TEMP register into W
		MOVWF 		STATUS ;Move W into STATUS register
		SWAPF			RES_W,F ;Swap W_TEMP
		SWAPF 			RES_W,W ;Swap W_TEMP into W
		RETURN

INTERRUPTION_TMR
			CALL 		RESPALDO_1
			CALL		OPERA
			BANKSEL TMR0
			MOVLW	0FA
			MOVWF	TMR0
			BCF		INTCON,T0IF
			BSF		INTCON,TMR0IE
		   	CALL 		RESPALDO_2
			RETFIE
			
OPERA: 		BSF			ADCON0,GO ;INICIA LA CONVERSION
           		BTFSC 		ADCON0,GO ;YA SE TERMINO LA CONVERSION?
            		GOTO $-1 ;NO? PREGUNTA DE NUEVO
            		BANKSEL 	ADRESL ;CAMBIO A BANCO1
            		MOVF 		ADRESL,W ;LEE LA PARTE MENOS SIGNIFICATIVA
			MOVWF 	DATO ;GUARDALO EN DATO
            		BANKSEL 	PORTD ;CAMBIO A BANCO 0
	        	MOVF 		DATO,W
			MOVWF	PORTD
	     		RETURN;REGRESO AL INICIO DEL PROGRAMA PRINCIPAL


INIT_ADQUI:
            		BANKSEL 	ADCON1 ;
           		 MOVLW	 B'10000000' ;JUSTIFICACIсN A LA IZQUIERDA
            		MOVWF 	ADCON1 ;Vdd Y Vss COMO Vref
            		BANKSEL	 TRISA ;
            		BSF 		TRISA,0 ;PONEMOS A RA0 COMO ENTRADA
            		BANKSEL 	ANSEL ;
           		 BSF 		ANSEL,0 ;PONEMOS A RA0 COMO ANALOGICO
           		 BANKSEL 	ADCON0 ;
           		 MOVLW 	B'11000001' ;ELEGIMOS EL RELOJ Frc DEL ADC
           		 MOVWF 	ADCON0 ;Y ENCENDEMOS EL CONVERTIDOR
          		  RETURN

	END	 